## files/drivers/net/wireless/realtek/rtl8192xb/Kconfig
```kconfig
# RTL8192XB 2.4GHz WiFi driver configuration

config RTL8192XB
	tristate "Realtek RTL8192XB 2.4GHz WiFi driver"
	depends on MAC80211 && PCI
	select FW_LOADER
	select CRC32
	help
	  This driver supports the Realtek RTL8192XB 2.4GHz WiFi chip
	  found on Realtek RTL8197F based routers (e.g., Tenda RX2L Pro).
	  
	  The driver implements:
	  - PCIe device probe and initialization
	  - Firmware loading (rtl8192xbfw_rom.bin)
	  - RF calibration
	  - mac80211 integration
	  
	  If unsure, say M.

config RTL8192XB_DEBUG
	bool "Enable RTL8192XB debug interface"
	depends on RTL8192XB && DEBUG_FS
	help
	  Enable debugfs interface for RTL8192XB driver.
```

## files/drivers/net/wireless/realtek/rtl8832br/Kconfig
```kconfig
# RTL8832BR 5GHz WiFi driver configuration

config RTL8832BR
	tristate "Realtek RTL8832BR 5GHz WiFi driver"
	depends on MAC80211 && PCI
	select FW_LOADER
	select CRC32
	help
	  This driver supports the Realtek RTL8832BR 5GHz WiFi chip
	  found on Realtek RTL8197F based routers (e.g., Tenda RX2L Pro).
	  
	  The driver implements:
	  - PCIe device probe and initialization
	  - Firmware loading
	  - RF calibration (IQK, TSSI, TXGAPK, PSD)
	  - Power management
	  - mac80211 integration
	  
	  If unsure, say M.

config RTL8832BR_DEBUG
	bool "Enable RTL8832BR debug interface"
	depends on RTL8832BR && DEBUG_FS
	help
	  Enable debugfs interface for RTL8832BR driver.
	  This provides access to calibration data, register dumps,
	  and RF calibration status for debugging.
```

## files/drivers/net/wireless/realtek/rtl8852b/Kconfig
```kconfig
# RTL8852B/PHL WiFi driver configuration

config RTL8852B
	tristate "Realtek RTL8852B/RTL8832BR PHL WiFi driver"
	depends on MAC80211 && PCI
	select FW_LOADER
	select CRC32
	help
	  This driver supports the Realtek RTL8852B and RTL8832BR WiFi chips
	  found on Realtek RTL8197F based routers (e.g., Tenda RX2L Pro).
	  
	  The PHL (PHY Layer) driver implements:
	  - PCIe device probe and initialization
	  - Firmware loading (RTL8852BFW)
	  - PHL/HALMAC framework
	  - MAC/PHY/RF calibration
	  - mac80211 integration
	  
	  If unsure, say M.

config RTL8852B_DEBUG
	bool "Enable RTL8852B debug interface"
	depends on RTL8852B && DEBUG_FS
	help
	  Enable debugfs interface for RTL8852B PHL driver.
```
